## techpack/KernelSU/kernel/Kconfig
```kconfig
menu "KernelSU"

config KSU
	tristate "KernelSU function support"
	default y
	help
	  Enable kernel-level root privileges on Android System.
	  Requires CONFIG_KPROBES for kernel hooking support.
	  To compile as a module, choose M here: the
	  module will be called kernelsu.

config KSU_DEBUG
	bool "KernelSU debug mode"
	depends on KSU
	default n
	help
	  Enable KernelSU debug mode.

config KSU_DISABLE_MANAGER
	bool "Disable KernelSU manager integration"
	depends on KSU
	default n
	help
	  Disable manager APK detection and manager-specific handling.
	  Root will be used in place of manager-only functionality.

config KSU_DISABLE_POLICY
	bool "Disable KernelSU policy profiles"
	depends on KSU
	default n
	help
	  Disable per-app root/non-root profile customization.
	  Escalation will always use the default full root profile, and
	  non-root handling will follow the global umount policy only.

config KSU_ALLOWLIST_WORKAROUND
	bool "KernelSU allowlist workaround"
	depends on KSU
	default n
	help
	  Enable workaround for broken allowlist save

# For easier extern ifdef handling
config KSU_MANUAL_HOOK
	bool "KernelSU manual hook mode."
	depends on KSU && KSU != m
	default y if !KPROBES
	default n
	help
	  Enable manual hook support.

config KSU_KPROBES_HOOK
	bool "KernelSU tracepoint+kretprobe hook"
	depends on KSU && !KSU_MANUAL_HOOK
	depends on KRETPROBES && KPROBES && HAVE_SYSCALL_TRACEPOINTS
	default y if KPROBES && KRETPROBES && HAVE_SYSCALL_TRACEPOINTS
	default y if !KSU_MANUAL_HOOK
	help
	  Enable KPROBES, KRETPROBES and TRACEPOINT hook for KernelSU core.
	  This should not be used on kernel below 5.10.

menu "KernelSU - SUSFS"
	depends on KSU && KSU != m

config KSU_SUSFS
	bool "SUSFS support"
	default n
	help
	  Enable the SUSFS filesystem-hiding extension for KernelSU.

config KSU_SUSFS_HAS_MAGIC_MOUNT
	bool "KernelSU uses magic mount"
	depends on KSU_SUSFS
	default n

config KSU_SUSFS_SUS_PATH
	bool "Hide configured paths"
	depends on KSU_SUSFS
	default n

config KSU_SUSFS_SUS_MOUNT
	bool "Hide configured mounts"
	depends on KSU_SUSFS
	default n

config KSU_SUSFS_AUTO_ADD_SUS_KSU_DEFAULT_MOUNT
	bool "Automatically hide KernelSU mounts"
	depends on KSU_SUSFS_SUS_MOUNT
	default n

config KSU_SUSFS_AUTO_ADD_SUS_BIND_MOUNT
	bool "Automatically hide bind mounts"
	depends on KSU_SUSFS_SUS_MOUNT
	default n

config KSU_SUSFS_SUS_KSTAT
	bool "Spoof configured file metadata"
	depends on KSU_SUSFS
	default n

config KSU_SUSFS_SUS_OVERLAYFS
	bool "Spoof overlayfs metadata"
	depends on KSU_SUSFS
	default n

config KSU_SUSFS_TRY_UMOUNT
	bool "Unmount configured paths for unprivileged apps"
	depends on KSU_SUSFS
	default n

config KSU_SUSFS_AUTO_ADD_TRY_UMOUNT_FOR_BIND_MOUNT
	bool "Automatically unmount bind mounts"
	depends on KSU_SUSFS_TRY_UMOUNT
	default n

config KSU_SUSFS_SPOOF_UNAME
	bool "Spoof uname"
	depends on KSU_SUSFS
	default n

config KSU_SUSFS_ENABLE_LOG
	bool "Runtime-configurable SUSFS logging"
	depends on KSU_SUSFS
	default n

config KSU_SUSFS_HIDE_KSU_SUSFS_SYMBOLS
	bool "Hide KernelSU and SUSFS symbols from kallsyms"
	depends on KSU_SUSFS
	default n

config KSU_SUSFS_SPOOF_CMDLINE_OR_BOOTCONFIG
	bool "Spoof cmdline or bootconfig"
	depends on KSU_SUSFS
	default n

config KSU_SUSFS_OPEN_REDIRECT
	bool "Redirect configured paths"
	depends on KSU_SUSFS
	default n

config KSU_SUSFS_SUS_SU
	bool "SUS-SU runtime hooks"
	depends on KSU_SUSFS && KPROBES && HAVE_KPROBES && KPROBE_EVENTS && KSU_KPROBES_HOOK
	default n

endmenu

endmenu
```
